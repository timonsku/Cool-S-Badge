## cool-s-firmware/boards/cool_s/Kconfig.cool_s
```kconfig
# Copyright (c) 2024 MASSDRIVER EI (massdriver.space)
# SPDX-License-Identifier: Apache-2.0

config BOARD_COOL_S
	select SOC_NRF52840_QIAA
```

## cool-s-firmware/boards/cool_s/board.yml
```yaml
board:
  name: cool_s
  full_name: Cool S Badge
  vendor: Diodes Delight
  socs:
  - name: nrf52840
```

## cool-s-firmware/boards/cool_s/cool_s_nrf52840_defconfig
```kconfig
# SPDX-License-Identifier: Apache-2.0

# Enable MPU
CONFIG_ARM_MPU=y

# Enable GPIO
CONFIG_GPIO=y

# Enable UART driver
CONFIG_SERIAL=y

# Enable console
# CONFIG_CONSOLE=y
# CONFIG_UART_CONSOLE=y

# CONFIG_CLOCK_CONTROL_NRF_K32SRC_RC=y
# CONFIG_CLOCK_CONTROL_NRF_K32SRC_500PPM=y

# CONFIG_BUILD_OUTPUT_UF2=y
CONFIG_BOARD_EARLY_INIT_HOOK=y
```
